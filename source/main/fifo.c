/***************************************************************************************************
 *   Project:
 *   Author:        Stulov Tikhon (kudesnick@inbox.ru)
 ***************************************************************************************************
 *   Distribution:
 *
 ***************************************************************************************************
 *   MCU Family:    STM32F
 *   Compiler:      ARMCC
 ***************************************************************************************************
 *   File:          fifo.c
 *   Description:
 *
 ***************************************************************************************************
 *   History:       2020/12/13 - file created
 *
 **************************************************************************************************/

/***************************************************************************************************
 *                                      INCLUDED FILES
 **************************************************************************************************/

#include "fifo.h"

#include <stdlib.h>

/***************************************************************************************************
 *                                       DEFINITIONS
 **************************************************************************************************/

/***************************************************************************************************
 *                                      PRIVATE TYPES
 **************************************************************************************************/

/***************************************************************************************************
 *                               PRIVATE FUNCTION PROTOTYPES
 **************************************************************************************************/

/***************************************************************************************************
 *                                       PRIVATE DATA
 **************************************************************************************************/

static buf_t buf_arr[BUF_CNT];

/***************************************************************************************************
 *                                       PUBLIC DATA
 **************************************************************************************************/

/***************************************************************************************************
 *                                      EXTERNAL DATA
 **************************************************************************************************/

/***************************************************************************************************
 *                              EXTERNAL FUNCTION PROTOTYPES
 **************************************************************************************************/

/***************************************************************************************************
 *                                    PRIVATE FUNCTIONS
 **************************************************************************************************/

/***************************************************************************************************
 *                                    WEAKLY FUNCTIONS
 **************************************************************************************************/

/***************************************************************************************************
 *                                    PUBLIC FUNCTIONS
 **************************************************************************************************/


buf_t *const buf_catch(const buf_state_t _head)
{
    for (int8_t i = BUF_CNT - 1; i >= 0; i--)
    {
        uint8_t *const result = (uint8_t *)&buf_arr[i];
        
        if (__LDREXB(result) == BUF_FREE)
        {
            if (__STREXB(_head, result) == 0)
            {
                return (buf_t *const)result;
            }
        }
        else
        {
            __CLREX();
        }
    }
    
    return NULL;
}

buf_t *const buf_get(const buf_state_t _state)
{
    for (int8_t i = BUF_CNT - 1; i >= 0; i--)
    {
        buf_t *const result = &buf_arr[i];
        
        if (result->head.state == _state)
        {
            return result;
        }
    }

    return NULL;
}

void buf_free(buf_t *const _buf)
{
    _buf->head.free_status = 0;
}

/***************************************************************************************************
 *                                       END OF FILE
 **************************************************************************************************/
